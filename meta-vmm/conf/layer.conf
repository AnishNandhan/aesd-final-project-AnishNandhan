## meta-vmm/conf/layer.conf
```bitbake
# We have a conf and classes directory, add to BBPATH
BBPATH .= ":${LAYERDIR}"

# We have recipes-* directories, add to BBFILES
BBFILES += "${LAYERDIR}/recipes-*/*/*.bb \
            ${LAYERDIR}/recipes-*/*/*.bbappend"

BBFILE_COLLECTIONS += "meta-vmm"
BBFILE_PATTERN_meta-vmm = "^${LAYERDIR}/"
BBFILE_PRIORITY_meta-vmm = "6"

LAYERDEPENDS_meta-vmm = "core"
LAYERSERIES_COMPAT_meta-vmm = "kirkstone"
```
